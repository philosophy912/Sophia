VERSION ""

NS_ :

BS_:

BU_: ICE

BO_ 1557 NMF_ICE: 8 ICE
 SG_ NMICEInd : 0|1@0+ (1,0) [0|0] "" Vector__XXX

BO_ 497 PPEI_Platform_General_Status: 8 Vector__XXX
 SG_ IgnKyPstn : 6|2@0+ (1,0) [0|0] ""  ICE

BO_ 298 LS_Device_Information: 8 Vector__XXX
 SG_ DDAjrSwAtv : 16|1@0+ (1,0) [0|0] ""  ICE

BO_ 485 PPEI_Steering_Wheel_Angle: 8 Vector__XXX
 SG_ StrWhAng : 15|16@0+ (1,0) [0|65535] ""  ICE
 SG_ StrWhAngV : 7|1@0+ (1,0) [0|0] ""  ICE

BO_ 381 Antilock_Brake_and_TC_Status_HS: 8 Vector__XXX
 SG_ VehSpdAvgDrvn_ABS : 19|15@0+ (1,0) [0|0] ""  ICE
 SG_ VehSpdAvgDrvnV_ABS : 61|1@0- (1,0) [0|0] ""  ICE

BA_DEF_  "BusType" STRING ;
BA_DEF_  "Manufacturer" STRING ;
BA_DEF_  "NmType" STRING ;
BA_DEF_  "NmBaseAddress" HEX 0 2047;
BA_DEF_  "NmMessageCount" INT 0 255;
BA_DEF_  "TpBaseAddress" HEX 0 2047;
BA_DEF_ BO_  "GenMsgCycleTime" INT 0 65535;
BA_DEF_ BO_  "GenMsgILSupport" ENUM  "No","Yes";
BA_DEF_ BO_  "GenMsgSendType" ENUM  "Cycle","not_used","not_used","not_used","not_used","not_used","not_used","IfActive","NoMsgSendType";
BA_DEF_ SG_  "GenSigSendType" ENUM  "Cycle","OnWrite","OnWriteWithRepetition","OnChange","OnChangeWithRepetition","IfActive","IfActiveWithRepetition","NoSigSendType";
BA_DEF_DEF_  "BusType" "CAN";
BA_DEF_DEF_  "Manufacturer" "Ford";
BA_DEF_DEF_  "NmType" "Ford-OSEK";
BA_DEF_DEF_  "NmBaseAddress" 1024;
BA_DEF_DEF_  "NmMessageCount" 128;
BA_DEF_DEF_  "TpBaseAddress" 1792;
BA_DEF_DEF_  "GenMsgCycleTime" 0;
BA_DEF_DEF_  "GenMsgILSupport" "Yes";
BA_DEF_DEF_  "GenMsgSendType" "Cycle";
BA_DEF_DEF_  "GenSigSendType" "Cycle";
BA_ "GenMsgCycleTime" BO_ 497 100;
BA_ "GenMsgCycleTime" BO_ 298 100;
BA_ "GenMsgILSupport" BO_ 485 0;
BA_ "GenMsgCycleTime" BO_ 485 10;
BA_ "GenMsgCycleTime" BO_ 381 100;
